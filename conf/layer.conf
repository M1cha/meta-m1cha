## conf/layer.conf
```bitbake
# We have a conf and classes directory, add to BBPATH
BBPATH .= ":${LAYERDIR}"

# We have recipes-* directories, add to BBFILES
BBFILES += "${LAYERDIR}/recipes-*/*/*.bb \
            ${LAYERDIR}/recipes-*/*/*.bbappend"

BBFILE_COLLECTIONS += "meta-m1cha"
BBFILE_PATTERN_meta-m1cha = "^${LAYERDIR}/"
BBFILE_PRIORITY_meta-m1cha = "6"

LAYERDEPENDS_meta-m1cha = "core"
LAYERSERIES_COMPAT_meta-m1cha = "warrior zeus"
```

## meta-resticsrv/conf/layer.conf
```bitbake
# We have a conf and classes directory, add to BBPATH
BBPATH .= ":${LAYERDIR}"

# We have recipes-* directories, add to BBFILES
BBFILES += "${LAYERDIR}/recipes-*/*/*.bb \
            ${LAYERDIR}/recipes-*/*/*.bbappend"

BBFILE_COLLECTIONS += "m1cha-resticsrv"
BBFILE_PATTERN_m1cha-resticsrv = "^${LAYERDIR}/"
BBFILE_PRIORITY_m1cha-resticsrv = "6"

LAYERDEPENDS_m1cha-resticsrv = "core m1cha"
LAYERSERIES_COMPAT_m1cha-resticsrv = "dunfell"
```

## meta/conf/distro/m1cha-distro-resticsrv.conf
```bitbake
DISTRO_FEATURES = " \
    acl \
    argp \
    ext2 \
    ipv4 \
    ipv6 \
    largefile \
    systemd \
    usbhost \
    xattr \
    vfat \
"
DISTRO_FEATURES_remove += " pulseaudio"

include conf/distro/poky.conf

DISTRO = "m1cha-distro-resticsrv"
TARGET_VENDOR = "-m1cha"

IMAGE_CLASSES_remove += "sdcard_image-sunxi"
IMAGE_FSTYPES_remove += "ext4 tar.gz sunxi-sdimg"
IMAGE_FSTYPES += "cpio.gz"
INITRAMFS_IMAGE = "m1cha-img-resticsrv"

RDEPENDS_${KERNEL_PACKAGE_NAME}-base = ""

VIRTUAL-RUNTIME_init_manager = "systemd"
VIRTUAL-RUNTIME_initscripts = "systemd-compat-units"

USERADDEXTENSION = "useradd-staticids"
USERADD_UID_TABLES += "conf/distro/include/m1cha-passwd"
USERADD_GID_TABLES += "conf/distro/include/m1cha-group"
```

## meta/conf/layer.conf
```bitbake
# We have a conf and classes directory, add to BBPATH
BBPATH .= ":${LAYERDIR}"

# We have recipes-* directories, add to BBFILES
BBFILES += "${LAYERDIR}/recipes-*/*/*.bb \
            ${LAYERDIR}/recipes-*/*/*.bbappend"

BBFILE_COLLECTIONS += "m1cha"
BBFILE_PATTERN_m1cha = "^${LAYERDIR}/"
BBFILE_PRIORITY_m1cha = "6"

LAYERDEPENDS_m1cha = "core rust-layer"
LAYERSERIES_COMPAT_m1cha = "dunfell"
```

## meta/conf/machine/orange-pi-pc-3.conf
```bitbake
#@TYPE: Machine
#@NAME: orange-pi-pc-3
#@DESCRIPTION: Machine configuration for the orange-pi-pc-3, based on Allwinner H6 CPU

PREFERRED_PROVIDER_u-boot ?= "u-boot-megous"
PREFERRED_PROVIDER_virtual/bootloader ?= "u-boot-megous"

KERNEL_CLASSES += "kernel-fitimage"
KERNEL_IMAGETYPE ?= "fitImage"
PREFERRED_PROVIDER_virtual/kernel ?= "linux-megous"

require conf/machine/include/sun50i.inc

KERNEL_DEVICETREE = "allwinner/sun50i-h6-orangepi-3.dtb"
UBOOT_MACHINE = "orangepi_3_defconfig"
UBOOT_ENTRYPOINT = "0x40080000"
UBOOT_LOADADDRESS = "0x40080000"

ATF_PLATFORM = "sun50i_h6"
PREFERRED_VERSION_atf-sunxi ?= "m1cha"

MACHINE_FEATURES += " \
    ext2 \
"
```

## west.yml
```yaml
manifest:
  defaults:
    remote: github
    revision: master

  remotes:
    - name: github
      url-base: ssh://git@github.com

    - name: openembedded
      url-base: git://git.openembedded.org

    - name: yoctoproject
      url-base: git://git.yoctoproject.org

  projects:
    - name: linux-sunxi/meta-sunxi
      path: meta-sunxi

    - name: meta-openembedded
      path: meta-openembedded
      remote: openembedded
      revision: thud

    - name: poky
      path: poky
      remote: yoctoproject
      revision: refs/tags/yocto-3.0.2

  self:
    path: meta-m1cha
    west-commands: scripts/west-commands.yml

  configs:
    zephyr:
      disabled: true
```
